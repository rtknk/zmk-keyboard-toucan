## boards/shields/toucan/Kconfig.shield
```kconfig
config SHIELD_TOUCAN_LEFT
    def_bool $(shields_list_contains,toucan_left)

config SHIELD_TOUCAN_RIGHT
    def_bool $(shields_list_contains,toucan_right)

config ZMK_INPUT_PROCESSOR_TOUCAN_CIRCLE
    bool "ZMK Input Processor for Toucan Circle Pad"
    default y
    depends on INPUT
```
